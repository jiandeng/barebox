## arch/arm/configs/friendlyarm_tiny210_defconfig
```kconfig
CONFIG_ARCH_S5PCxx=y
CONFIG_CPU_V7=y
CONFIG_CPU_32v7=y
CONFIG_BOARDINFO="Tiny 210"
CONFIG_ARCH_BAREBOX_MAX_BARE_INIT_SIZE=0x1ff0
CONFIG_ARCH_SAMSUNG=y
CONFIG_CPU_S5PV210=y
CONFIG_MACH_TINY210=y
CONFIG_S3C_LOWLEVEL_INIT=y
CONFIG_S3C_PLL_INIT=y
CONFIG_S3C_SDRAM_INIT=y
CONFIG_CMD_LED=y
CONFIG_CMD_LED_TRIGGER=y
CONFIG_DRIVER_SERIAL_S3C=y
CONFIG_LED=y
CONFIG_LED_GPIO=y
CONFIG_LED_TRIGGERS=y
CONFIG_NET=y
CONFIG_NET_PING=y
CONFIG_DRIVER_NET_DM9K=y
CONFIG_DEFAULT_ENVIRONMENT_GENERIC_NEW=y
CONFIG_DEFAULT_ENVIRONMENT_PATH="arch/arm/boards/friendlyarm-tiny210/env"
CONFIG_CMDLINE_EDITING=y
CONFIG_AUTO_COMPLETE=y
CONFIG_FS_TFTP=y
CONFIG_CMD_TFTP=y
CONFIG_CMD_GO=y
CONFIG_CMD_RESET=y
CONFIG_CMD_TIMEOUT=y
CONFIG_CMD_EXPORT=y
CONFIG_MTD=y
CONFIG_MTD_RAW_DEVICE=y
CONFIG_NAND=y
CONFIG_NAND_S5PV210=y
CONFIG_NAND_ECC_SOFT=n
CONFIG_NAND_ECC_HW_SYNDROME=n
CONFIG_CMD_PARTITION=y
CONFIG_CMD_FLASH=y
CONFIG_CMD_MTEST=y
CONFIG_CMD_NANDTEST=y
CONFIG_CMD_NANDDUMP=y
CONFIG_PARTITION=y
CONFIG_MALLOC_SIZE=0x800000
CONFIG_CMD_EDIT=y
CONFIG_CMD_SAVEENV=y
CONFIG_CMD_LOADENV=y
CONFIG_S5P_NAND_BOOT=y
CONFIG_UBI=y
CONFIG_TEXT_BASE=0x23000000
```
